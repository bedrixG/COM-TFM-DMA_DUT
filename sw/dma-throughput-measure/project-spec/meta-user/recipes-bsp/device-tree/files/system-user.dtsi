/include/ "system-conf.dtsi"
/ {
    dma_proxy {
        compatible = "xlnx,dma_proxy";
        dmas = <&axi_dma_0 0 &axi_dma_0 1>;   /* 0 = MM2S (tx), 1 = S2MM (rx) */
        dma-names = "dma_proxy_tx", "dma_proxy_rx";
    }; 
};


/* SD */
&sdhci1{
disable-wp;
no-1-8-v;
};

/* USB */

&dwc3_0{
status="okay";
dr_mode="host";
};
