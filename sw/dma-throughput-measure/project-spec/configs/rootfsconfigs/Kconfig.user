## sw/dma-throughput-measure/project-spec/configs/rootfsconfigs/Kconfig.user
```kconfig
menu "user packages " 
config dma-proxy  
	 bool "dma-proxy"
	 help
	
config gpio-demo  
	 bool "gpio-demo"
	 help
	
config peekpoke  
	 bool "peekpoke"
	 help
	
endmenu
```
